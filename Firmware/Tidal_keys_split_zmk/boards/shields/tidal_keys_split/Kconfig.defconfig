## Firmware/Tidal_keys_split_zmk/boards/shields/tidal_keys_split/Kconfig.defconfig
```kconfig
if SHIELD_TIDAL_KEYS_SPLIT_LEFT

config ZMK_KEYBOARD_NAME
    default "tidal_keys"

config ZMK_SPLIT_ROLE_CENTRAL
    default y

endif # SHIELD_TIDAL_KEYS_SPLIT_LEFT

if SHIELD_TIDAL_KEYS_SPLIT_LEFT || SHIELD_TIDAL_KEYS_SPLIT_RIGHT

config ZMK_SPLIT
    default y

config ZMK_SPLIT_BLE
    default y

endif # SHIELD_TIDAL_KEYS_SPLIT_LEFT || SHIELD_TIDAL_KEYS_SPLIT_RIGHT
```

## Firmware/Tidal_keys_split_zmk/boards/shields/tidal_keys_split/Kconfig.shield
```kconfig
config SHIELD_TIDAL_KEYS_SPLIT_LEFT
    def_bool $(shields_list_contains,tidal_keys_split_left)

config SHIELD_TIDAL_KEYS_SPLIT_RIGHT
    def_bool $(shields_list_contains,tidal_keys_split_right)
```
